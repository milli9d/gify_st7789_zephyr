## prj.conf
```kconfig
CONFIG_ASSERT=y

CONFIG_ESPTOOLPY_FLASHMODE_QIO=y
CONFIG_ESPTOOLPY_FLASHFREQ_80M=y
CONFIG_ESPTOOLPY_FLASHSIZE_8MB=y

# bootloader
# CONFIG_BOOTLOADER_MCUBOOT=y

# compiler settings
CONFIG_CPP=y
CONFIG_STD_CPP2B=y
CONFIG_REQUIRES_FULL_LIBCPP=y
CONFIG_CPP_EXCEPTIONS=y
CONFIG_CPP_RTTI=y

CONFIG_NEWLIB_LIBC=y
CONFIG_COMMON_LIBC_ASCTIME_R=y
CONFIG_COMMON_LIBC_CTIME_R=y
CONFIG_COMMON_LIBC_MALLOC=y
CONFIG_NEWLIB_LIBC_FLOAT_PRINTF=y
CONFIG_NEWLIB_LIBC_HEAP_LISTENER=y

CONFIG_STD_C23=y
CONFIG_GNU_C_EXTENSIONS=y
CONFIG_DEBUG_OPTIMIZATIONS=y
CONFIG_COMPILER_WARNINGS_AS_ERRORS=y
CONFIG_COMPILER_SAVE_TEMPS=y
CONFIG_FORTIFY_SOURCE_RUN_TIME=y
# CONFIG_MISRA_SANE=y
CONFIG_HEAP_MEM_POOL_SIZE=20000

CONFIG_SYS_HASH_FUNC32=y
CONFIG_SYS_HASH_MAP=y
CONFIG_SHARED_MULTI_HEAP=y

#debug settings
CONFIG_PRINTK=y

CONFIG_LOG=y
CONFIG_LOG_DEFAULT_LEVEL=2
CONFIG_SHELL_LOG_BACKEND=y
CONFIG_LOG_BACKEND_UART=y

# shell settings
CONFIG_SHELL=y
CONFIG_SHELL_PROMPT_UART="ST7789:~$ "

CONFIG_FILE_SYSTEM_SHELL=y

CONFIG_GPIO=y
CONFIG_GPIO_SHELL=y

CONFIG_I2C=y
CONFIG_I2C_SHELL=y

CONFIG_SPI=y
CONFIG_SPI_SHELL=y

CONFIG_DISPLAY=y
CONFIG_INPUT=y
CONFIG_INPUT_EVENT_DUMP=y

CONFIG_CHARACTER_FRAMEBUFFER=y
CONFIG_SHELL=y
CONFIG_CHARACTER_FRAMEBUFFER_SHELL=y
CONFIG_HEAP_MEM_POOL_SIZE=16384

CONFIG_IPC_SERVICE=y
CONFIG_LOG_BACKEND_IPC_SERVICE=y
```

## src/main.cpp
```c
#include <stdio.h>
#include <stdlib.h>
#include <ctime>

#include <zephyr/kernel.h>
#include <zephyr/device.h>
#include <zephyr/display/cfb.h>
#include <zephyr/drivers/gpio.h>

#include "pin_defines.hpp"

int main()
{

    while (1) {
        printk("Welcome to ST7789 demo!\n");
        k_sleep(K_SECONDS(rand() % 30u));
    }

    return 0;
}
```

## include/pin_defines.hpp
```c
#pragma once

#include <stdio.h>
#include <stdlib.h>

#include <zephyr/kernel.h>
#include <zephyr/drivers/gpio.h>

#define ZEPHYR_USER_NODE DT_PATH(zephyr_user)

#define POWER_OFF_GPIO DT_GPIO_LABEL(ZEPHYR_USER_NODE, power_off_gpios)
#define GYRO_CS_GPIO DT_GPIO_LABEL(ZEPHYR_USER_NODE, gyro_cs_gpios)
#define BUMPER_LED_GPIO GPIO_DT_SPEC_GET(ZEPHYR_USER_NODE, bumper_leds_gpios)

#define TFT1_CS_GPIO DT_GPIO_LABEL(ZEPHYR_USER_NODE, tft1_cs_gpios)
#define TFT1_LED_GPIO DT_GPIO_LABEL(ZEPHYR_USER_NODE, tft1_led_gpios)

#define TFT2_CS_GPIO DT_GPIO_LABEL(ZEPHYR_USER_NODE, tft2_cs_gpios)
#define TFT2_LED_GPIO DT_GPIO_LABEL(ZEPHYR_USER_NODE, tft2_led_gpios)
```
